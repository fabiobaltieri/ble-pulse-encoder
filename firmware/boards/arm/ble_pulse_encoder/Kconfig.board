## firmware/boards/arm/ble_pulse_encoder/Kconfig.board
```kconfig
config BOARD_BLE_PULSE_ENCODER
	bool "BLE Pulse Encoder"
	depends on SOC_NRF52832_QFAA
```

## firmware/boards/arm/ble_pulse_encoder/Kconfig.defconfig
```kconfig
if BOARD_BLE_PULSE_ENCODER

config BOARD
	default "ble_pulse_encoder"

config BT_CTLR
	default BT

config SOC_DCDC_NRF52X
	default y

endif
```
